## drivers/iio/stm/accel/st_acc33/Kconfig
```kconfig
# SPDX-License-Identifier: GPL-2.0-only

config IIO_ST_ACC33
	tristate "STMicroelectronics LIS3DH/LIS2DH/LIS2DH12/LSM303AGR/IIS2DH Accelerometer driver"
	depends on (I2C || SPI_MASTER) && SYSFS
	select IIO_ST_ACC33_I2C if (I2C)
	select IIO_ST_ACC33_SPI if (SPI_MASTER)
	select IIO_BUFFER
	select IIO_KFIFO_BUF
	help
	 Say yes here to build support for STMicroelectronics accelerometers:
	 LIS3DH, LIS2DH, LIS2DH12, LSM303AGR, IIS2DH.

	 This driver can also be built as a module. If so, will be created
	 these modules:
	 - st_ac33_core (core functions for the driver [it is mandatory]);
	 - st_ac33_i2c (necessary for the I2C devices [optional*]);
	 - st_ac33_spi (necessary for the SPI devices [optional*]);

	 (*) one of these is necessary to do something.

config IIO_ST_ACC33_I2C
	tristate
	depends on IIO_ST_ACC33

config IIO_ST_ACC33_SPI
	tristate
	depends on IIO_ST_ACC33
```

## drivers/iio/stm/accel/st_h3lis331dl/Kconfig
```kconfig
# SPDX-License-Identifier: GPL-2.0-only

config IIO_ST_H3LIS331DL
        tristate "STMicroelectronics H3LIS331DL/LIS331DLH sensor"
        depends on (I2C || SPI)
        select IIO_BUFFER
        select IIO_KFIFO_BUF
        select IIO_TRIGGERED_BUFFER
        select IIO_ST_H3LIS331DL_I2C if (I2C)
        select IIO_ST_H3LIS331DL_SPI if (SPI_MASTER)
        help
          Say yes here to build support for STMicroelectronics H3LIS331DL and
          LIS331DLH accelerometer sensors.

          To compile this driver as a module, choose M here: the module
          will be called st_h3lis331dl.

config IIO_ST_H3LIS331DL_I2C
        tristate
        select REGMAP_I2C
        depends on IIO_ST_H3LIS331DL

config IIO_ST_H3LIS331DL_SPI
        tristate
        select REGMAP_SPI
        depends on IIO_ST_H3LIS331DL
```

## drivers/iio/stm/accel/st_ism303dac_accel/Kconfig
```kconfig
# SPDX-License-Identifier: GPL-2.0-only

config IIO_ST_ISM303DAC_ACCEL
	tristate "STMicroelectronics ISM303DAC Accelerometer Driver"
	depends on (I2C || SPI_MASTER) && SYSFS
	select IIO_BUFFER
	select IIO_TRIGGERED_BUFFER
	select IIO_ST_ISM303DAC_ACCEL_I2C if (I2C)
	select IIO_ST_ISM303DAC_ACCEL_SPI if (SPI)
	help
	 Say yes here to build support for the ISM303DAC
	 accelerometers.

config IIO_ST_ISM303DAC_ACCEL_I2C
	tristate
	depends on IIO_ST_ISM303DAC_ACCEL
	depends on I2C

config IIO_ST_ISM303DAC_ACCEL_SPI
	tristate
	depends on IIO_ST_ISM303DAC_ACCEL
	depends on SPI

config IIO_ST_ISM303DAC_ACCEL_EN_BASIC_FEATURES
	bool "Enable internal basic features event detection"
	depends on IIO_ST_ISM303DAC_ACCEL
	help
	 Enable internal event detection features like: tap and double tap.
	 If this feature is enabled it is necessary to extend iio_chan_type_name_spec
	 array in industrialio-core.c by adding the custom sensor-types used by this
	 driver.

config ST_ISM303DAC_ACCEL_IIO_LIMIT_FIFO
	int "Limit fifo read lenght (#n byte)"
	depends on IIO_ST_ISM303DAC_ACCEL
	range 0 1536
	default 0
	help
	 Limit atomic fifo read to #n byte. In some platform i2c/spi read
	 can be limited by software or hardware.

	 Set 0 to disable the limit.
```

## drivers/iio/stm/accel/st_lis2ds12/Kconfig
```kconfig
# SPDX-License-Identifier: GPL-2.0-only

config IIO_ST_LIS2DS12
	tristate "STMicroelectronics LIS2DS12 Accelerometer Driver"
	depends on (I2C || SPI_MASTER) && SYSFS
	select IIO_BUFFER
	select IIO_TRIGGERED_BUFFER
	select IIO_ST_LIS2DS12_I2C if (I2C)
	select IIO_ST_LIS2DS12_SPI if (SPI)
	help
	 Say yes here to build support for the LIS2DS12
	 accelerometer.

config IIO_ST_LIS2DS12_I2C
	tristate
	depends on IIO_ST_LIS2DS12
	depends on I2C

config IIO_ST_LIS2DS12_SPI
	tristate
	depends on IIO_ST_LIS2DS12
	depends on SPI

config IIO_ST_LIS2DS12_EN_BASIC_FEATURES
	bool "Enable internal basic features event detection"
	depends on IIO_ST_LIS2DS12
	help
	 Enable internal event detection features like: tap, double tap,
	 step counter, step detection, significant motion and tilt. If this
	 feature is enabled it is necessary to extend iio_chan_type_name_spec
	 array in industrialio-core.c by adding the custom sensor-types used
	 by this driver.

config ST_LIS2DS12_IIO_LIMIT_FIFO
	int "Limit fifo read lenght (#n byte)"
	depends on IIO_ST_LIS2DS12
	range 0 1536
	default 0
	help
	 Limit atomic fifo read to #n byte. In some platform i2c/spi read
	 can be limited by software or hardware.

	 Set 0 to disable the limit.
```

## drivers/iio/stm/accel/st_lis2du12/Kconfig
```kconfig
# SPDX-License-Identifier: GPL-2.0-only

config IIO_ST_LIS2DU12
	tristate "STMicroelectronics LIS2DU12 Accelerometer Driver"
	depends on (I2C || SPI || I3C)
	select IIO_BUFFER
	select IIO_KFIFO_BUF
	select IIO_ST_LIS2DU12_I2C if (I2C)
	select IIO_ST_LIS2DU12_SPI if (SPI)
	select IIO_ST_LIS2DU12_I3C if (I3C)
	help
	 Say yes here to build support for the LIS2DU12 accelerometer.

	 This driver can also be built as a module. If so, will be created
	 these modules:
	  - st_lisdu12 (core functions for the driver [it is mandatory]);
	  - st_lisdu12_i2c (necessary for the I2C devices [optional*]);
	  - st_lisdu12_spi (necessary for the SPI devices [optional*]);
	  - st_lisdu12_i3c (necessary for the I3C devices [optional*]);

	 (*) one of these is necessary to do something.

config IIO_ST_LIS2DU12_I2C
	tristate
	depends on IIO_ST_LIS2DU12
	depends on I2C

config IIO_ST_LIS2DU12_SPI
	tristate
	depends on IIO_ST_LIS2DU12
	depends on SPI

config IIO_ST_LIS2DU12_I3C
	tristate
	depends on IIO_ST_LIS2DU12
	depends on I3C
```

## drivers/iio/stm/accel/st_lis2dw12/Kconfig
```kconfig
# SPDX-License-Identifier: GPL-2.0-only

config IIO_ST_LIS2DW12
	tristate "STMicroelectronics LIS2DW12/IIS2DLPC/AIS2IH Accelerometer Driver"
	depends on (I2C || SPI)
	select IIO_BUFFER
	select IIO_KFIFO_BUF
	select IIO_ST_LIS2DW12_I2C if (I2C)
	select IIO_ST_LIS2DW12_SPI if (SPI)
	help
	 Say yes here to build support for the LIS2DW12, IIS2DLPC and AIS2IH accelerometer.

	 This driver can also be built as a module. If so, will be created
	 these modules:
	 - st_lis2dw12 (core functions for the driver [it is mandatory]);
	 - st_lis2dw12_i2c (necessary for the I2C devices [optional*]);
	 - st_lis2dw12_spi (necessary for the SPI devices [optional*]);

	 (*) one of these is necessary to do something.

config IIO_ST_LIS2DW12_I2C
	tristate
	depends on IIO_ST_LIS2DW12
	depends on I2C

config IIO_ST_LIS2DW12_SPI
	tristate
	depends on IIO_ST_LIS2DW12
	depends on SPI

config IIO_ST_LIS2DW12_STORE_SAMPLE_FIFO_SUSPEND
	bool "Store accel sample in FIFO during suspend"
	depends on IIO_ST_LIS2DW12
	help
	 When enabled the sensor store accel samples in internal HW FIFO during
	 system suspend. After system resume all stored data will be pushed to
	 the user space.
```

## drivers/iio/stm/accel/st_lis2hh12/Kconfig
```kconfig
# SPDX-License-Identifier: GPL-2.0-only

config IIO_ST_LIS2HH12
	tristate "STMicroelectronics LIS2HH12 Accelerometer driver"
	depends on (I2C || SPI_MASTER) && SYSFS
	select IIO_BUFFER
	select IIO_TRIGGERED_BUFFER
	select IIO_ST_LIS2HH12_I2C if (I2C)
	select IIO_ST_LIS2HH12_SPI if (SPI_MASTER)
	help
	 Say yes here to build support for the LIS2HH12 accelerometer.

config IIO_ST_LIS2HH12_I2C
	tristate
	select REGMAP_I2C
	depends on IIO_ST_LIS2HH12

config IIO_ST_LIS2HH12_SPI
	tristate
	select REGMAP_SPI
	depends on IIO_ST_LIS2HH12
```

## drivers/iio/stm/accel/st_lis3dhh/Kconfig
```kconfig
# SPDX-License-Identifier: GPL-2.0-only

config IIO_ST_LIS3DHH
	tristate "STMicroelectronics LIS3DHH/IIS3DHHC Accelerometer driver"
	depends on SPI_MASTER && SYSFS
	select IIO_BUFFER
	select IIO_KFIFO_BUF
	select REGMAP_SPI
	help
	 Say yes here to build support for STMicroelectronics LIS3DHH and
	 IIS3DHHC accelerometers

	 This driver can also be built as a module. If so, will be named
	 st_lis3dhh
```

## drivers/iio/stm/humidity/Kconfig
```kconfig
# SPDX-License-Identifier: GPL-2.0-only
#
# IIO humidity drivers configuration
#
# When adding new entries keep the list in alphabetical order

menu "Humidity"

source "drivers/iio/stm/humidity/hts221/Kconfig"

endmenu
```

## drivers/iio/stm/humidity/hts221/Kconfig
```kconfig
# SPDX-License-Identifier: GPL-2.0-only

config ST_HTS221_IIO
	tristate "STMicroelectronics HTS221 sensor Driver"
	depends on (I2C || SPI)
	select IIO_BUFFER
	select IIO_TRIGGERED_BUFFER
	select ST_HTS221_I2C_IIO if (I2C)
	select ST_HTS221_SPI_IIO if (SPI_MASTER)
	help
	 Say yes here to build support for STMicroelectronics HTS221
	 temperature-humidity sensor

	 To compile this driver as a module, choose M here: the module
	 will be called hts221.

config ST_HTS221_I2C_IIO
	tristate
	depends on ST_HTS221_IIO
	select REGMAP_I2C

config ST_HTS221_SPI_IIO
	tristate
	depends on ST_HTS221_IIO
	select REGMAP_SPI
```

## drivers/iio/stm/imu/st_ism330dhcx/Kconfig
```kconfig
# SPDX-License-Identifier: GPL-2.0-only
config IIO_ST_ISM330DHCX
	tristate "STMicroelectronics ISM330DHCX sensor"
	depends on (I2C || SPI)
	select IIO_BUFFER
	select IIO_TRIGGERED_BUFFER
	select IIO_ST_ISM330DHCX_I2C if (I2C)
	select IIO_ST_ISM330DHCX_SPI if (SPI_MASTER)
	help
	  Say yes here to build support for STMicroelectronics ISM330DHCX imu
	  sensor.

	  To compile this driver as a module, choose M here: the module
	  will be called st_ism330dhcx.

config IIO_ST_ISM330DHCX_EN_BASIC_FEATURES
	bool "Enable internal basic features event detection"
	depends on IIO_ST_ISM330DHCX
	help
	  Enable internal event detection features like: free fall, sleep
	  change, wake-up, 6D orientation. If this feature is enabled it is
	  necessary to extend the iio_chan_type_name_spec array in industrialio-
	  core.c by adding the custom types used by this driver.

	  WARNING If this feature is enabled, it is necessary to extend the
	  iio_chan_type_name_spec array in industrialio-core.c by adding the
	  custom sensor-types used by this driver; otherwise, during the
	  registration phase of the custom sensors on the iio core, a crash
	  could occur due to access to unallocated memory.

comment "WARNING ! If you don't know what you're doing, leave this flag in the default state."
	depends on IIO_ST_ISM330DHCX_EN_BASIC_FEATURES

config IIO_ST_ISM330DHCX_I2C
	tristate
	depends on IIO_ST_ISM330DHCX

config IIO_ST_ISM330DHCX_SPI
	tristate
	depends on IIO_ST_ISM330DHCX
```

## drivers/iio/stm/imu/st_lsm6dsox/Kconfig
```kconfig
# SPDX-License-Identifier: GPL-2.0-only

config IIO_ST_LSM6DSOX
	tristate "STMicroelectronics LSM6DSOX sensor"
	depends on (I2C || SPI)
	select IIO_BUFFER
	select IIO_KFIFO_BUF
	select IIO_ST_LSM6DSOX_I2C if (I2C)
	select IIO_ST_LSM6DSOX_SPI if (SPI_MASTER)
	select IIO_ST_LSM6DSOX_I3C if (I3C)
	help
	  Say yes here to build support for STMicroelectronics
	  LSM6DSO/LSM6DSOX/LSM6DSO32/LSM6DSO32X imu sensors.

	  To compile this driver as a module, choose M here: the module
	  will be called st_lsm6dsox.

config IIO_ST_LSM6DSOX_I2C
	tristate
	select REGMAP_I2C
	depends on IIO_ST_LSM6DSOX

config IIO_ST_LSM6DSOX_SPI
	tristate
	select REGMAP_SPI
	depends on IIO_ST_LSM6DSOX

config IIO_ST_LSM6DSOX_I3C
	tristate
	depends on IIO_ST_LSM6DSOX
	select REGMAP_I3C

config IIO_ST_LSM6DSOX_MLC_PRELOAD
	bool "Preload some examples on MLC/FSM core"
	depends on IIO_ST_LSM6DSOX
	help
	  Select yes if you want to preload some examples on machine learning core
	  and finite state machine.

	  The examples code is a 6D position recognition and is hardcoded in the
	  driver in the mlcdata structure.

config IIO_ST_LSM6DSOX_ASYNC_HW_TIMESTAMP
	bool "Enable async hw timestamp read"
	depends on IIO_ST_LSM6DSOX
	help
	  Enable async task that sends over hw timestamp events.
```

## drivers/iio/stm/magnetometer/Kconfig
```kconfig
# SPDX-License-Identifier: GPL-2.0-only
#
# Magnetometer sensors
#
# When adding new entries keep the list in alphabetical order

menu "Magnetometer sensors"

source "drivers/iio/stm/magnetometer/st_mag3d/Kconfig"
source "drivers/iio/stm/magnetometer/st_mag40/Kconfig"

endmenu
```

## drivers/iio/stm/pressure/Kconfig
```kconfig
# SPDX-License-Identifier: GPL-2.0-only
#
# IIO pressure drivers configuration
#
# When adding new entries keep the list in alphabetical order

menu "Pressure"

source "drivers/iio/stm/pressure/st_lps22df/Kconfig"
source "drivers/iio/stm/pressure/st_lps33hw/Kconfig"
source "drivers/iio/stm/pressure/st_lps22hh/Kconfig"
source "drivers/iio/stm/pressure/st_lps22hb/Kconfig"
source "drivers/iio/stm/pressure/st_ilps22qs/Kconfig"

endmenu
```

## drivers/iio/stm/pressure/st_ilps22qs/Kconfig
```kconfig
# SPDX-License-Identifier: GPL-2.0-only

config ST_ILPS22QS_IIO
	tristate "STMicroelectronics ILPS22QS sensor"
	depends on (I2C || SPI_MASTER) && SYSFS
	select IIO_BUFFER
	select IIO_KFIFO_BUF
	select ST_ILPS22QS_I2C_IIO if (I2C)
	select ST_ILPS22QS_SPI_IIO if (SPI)
	help
	 This driver supports ILPS22QS sensor. This driver can be
	 built as a module. The module will be called st-ilps22qs.

config ST_ILPS22QS_I2C_IIO
	tristate
	depends on ST_ILPS22QS_IIO

config ST_ILPS22QS_SPI_IIO
	tristate
	depends on ST_ILPS22QS_IIO
```

## drivers/iio/stm/pressure/st_lps22df/Kconfig
```kconfig
# SPDX-License-Identifier: GPL-2.0-only

config ST_LPS22DF_IIO
	tristate "STMicroelectronics LPS22DF/LPS28DFW sensor"
	depends on (I2C || SPI_MASTER) && SYSFS
	select IIO_BUFFER
	select IIO_KFIFO_BUF
	select ST_LPS22DF_I2C_IIO if (I2C)
	select ST_LPS22DF_SPI_IIO if (SPI)
	help
	 Say yes here to build support for the ST MEMS LPS22DF/LPS28DFW
	 pressure and temperature  sensor.

	 This driver can be built as a module. The module will be called
	 st-lps22df.

config ST_LPS22DF_I2C_IIO
	tristate
	depends on ST_LPS22DF_IIO

config ST_LPS22DF_SPI_IIO
	tristate
	depends on ST_LPS22DF_IIO
```

## drivers/iio/stm/pressure/st_lps22hb/Kconfig
```kconfig
# SPDX-License-Identifier: GPL-2.0-only

config ST_LPS22HB_IIO
	tristate "STMicroelectronics LPS22HB sensor"
	depends on (I2C || SPI_MASTER) && SYSFS
	select IIO_BUFFER
	select IIO_KFIFO_BUF
	select ST_LPS22HB_I2C_IIO if (I2C)
	select ST_LPS22HB_SPI_IIO if (SPI)
	help
	 This driver supports LPS22HB pressure sensor. This driver can be
	 built as a module. The module will be called st-lps22hb.

config ST_LPS22HB_I2C_IIO
	tristate
	select REGMAP_I2C
	depends on ST_LPS22HB_IIO

config ST_LPS22HB_SPI_IIO
	tristate
	select REGMAP_SPI
	depends on ST_LPS22HB_IIO
```

## drivers/iio/stm/pressure/st_lps33hw/Kconfig
```kconfig
# SPDX-License-Identifier: GPL-2.0-only

config ST_LPS33HW_IIO
	tristate "STMicroelectronics LPS33HW sensor"
	depends on (I2C || SPI_MASTER) && SYSFS
	select IIO_BUFFER
	select IIO_KFIFO_BUF
	select ST_LPS33HW_I2C_IIO if (I2C)
	select ST_LPS33HW_SPI_IIO if (SPI)
	help
	 This driver supports LPS33HW pressure sensors. This driver can be
	 built as a module. The module will be called st-lps33hw.

config ST_LPS33HW_I2C_IIO
	tristate
	depends on ST_LPS33HW_IIO

config ST_LPS33HW_SPI_IIO
	tristate
	depends on ST_LPS33HW_IIO
```

## drivers/iio/stm/temperature/Kconfig
```kconfig
# SPDX-License-Identifier: GPL-2.0-only
#
# IIO temperature drivers configuration
#
# When adding new entries keep the list in alphabetical order

menu "Temperature"

source "drivers/iio/stm/temperature/stts22h/Kconfig"

endmenu
```
