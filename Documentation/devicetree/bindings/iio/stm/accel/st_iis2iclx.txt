## Documentation/devicetree/bindings/iio/stm/accel/st_iis2iclx.txt
```
* st_iis2iclx driver for imu MEMS sensors

Required properties for all bus drivers:
- compatible: must be one of:
              "st,iis2iclx"

Required properties for the i2c bindings:
- reg: i2c slave address.

Required properties for the spi bindings:
- reg: the chip select index.

- spi-max-frequency: maximal bus speed, should be set to 10000000 unless
                     constrained by external circuitry.

Optional properties for all bus drivers:
- vdd-supply:     an optional regulator that needs to be on to provide
                  VDD power to the sensor.

- vddio-supply:   an optional regulator that needs to be on to provide
                  the VDD IO power to the sensor.

- st,int-pin:     the pin on the package that will be used to signal
                  "data ready". Valid values: 1 or 2, default: 1.

- st,mlc-int-pin: the pin on the package that will be used to signal
                  MLC/FSM event. Valid values: 1 for int pin 1, 2 for
                  int pin 2 or 3 for both int pin, default: st,int-pin.

- mount-matrix:   mount rotation matrix.
                  Refer to iio/mount-matrix.txt for details.

- interrupts:     interrupt mapping for IRQ. It should be configured
                  with flags IRQ_TYPE_LEVEL_HIGH or IRQ_TYPE_LEVEL_LOW.

                  Refer to interrupt-controller/interrupts.txt for
                  generic interrupt client node bindings.

- st,module_id:   module identifier.
                  This is used by user-space to identify which devices
                  are part of the same module (particularly important for
                  supporting multiple sensors of the same type).

- st,xl_lpf_div: Bandwidth XL ODR divider, if set the value must be within
                 the range [2, 800].

- drive-open-drain: configure int pin in open drain. Default is disabled.

- drive-pullup-shub: enable pull up on the i2c master interface. Default is disabled.

- wakeup-source:  https://www.kernel.org/doc/Documentation/devicetree/bindings/power/wakeup-source.txt

Example for an spi iis2iclx device node:

iis2iclx-accel@0 {
        compatible = "st,iis2iclx";
        reg = <0x0>;
        spi-max-frequency = <10000000>;
        interrupt-parent = <&gpio0>;
        interrupts = <0 IRQ_TYPE_LEVEL_HIGH>;
        vddio-supply = <&sensors_vddio>;
        vdd-supply = <&sensors_vdd>;
        st,int-pin = <1>;
        st,mlc-int-pin = <2>;
        st,module_id = <1>;
        mount-matrix = "1", "0", "0",
                       "0", "1", "0",
                       "0", "0", "1";
};

Example for an i2c iis2iclx device node (SA0 pulled down):

iis2iclx-accel@0x6a {
        compatible = "st,iis2iclx";
        reg = <0x6a>;
        interrupt-parent = <&gpio0>;
        interrupts = <0 IRQ_TYPE_LEVEL_HIGH>;
        vddio-supply = <&sensors_vddio>;
        vdd-supply = <&sensors_vdd>;
        st,int-pin = <1>;
        st,mlc-int-pin = <2>;
        mount-matrix = "1", "0", "0",
                       "0", "1", "0",
                       "0", "0", "1";
};
```

## Documentation/devicetree/bindings/iio/stm/accel/st_lis2duxs12.txt
```
* lis2duxs12 driver for accel MEMS sensors

Required properties for all bus drivers:
- compatible: must be one of:
              "st,lis2dux12"
              "st,lis2duxs12"
              "st,iis2dulpx"

Required properties for the i2c bindings:
- reg: i2c slave address.

Required properties for the spi bindings:
- reg: the chip select index.

- spi-max-frequency: maximal bus speed, should be set to 10000000 unless
                     constrained by external circuitry.

Optional properties for all bus drivers:
- st,int-pin:  the pin on the package that will be used to signal when
               sensor data are available. Valid values: 1 or 2, default: 1.

- st,md-int-pin: xl-based event interrupt pins (sleep-change, wake-up, free fall,
                 tap, 6D and timestamp). Valid values: 1 or 2, default: 1.

- st,emb-int-pin: interrupt pin for embedded functions (step detector, tilt
                  and significant motion). Valid values: 1 or 2, default: 1.

- interrupts:  interrupt mapping for IRQ. It should be configured with
               flags IRQ_TYPE_LEVEL_HIGH.

               Refer to interrupt-controller/interrupts.txt for generic
               interrupt client node bindings.

- pd_dis_int1: disable pull down on int1 pin.

- pd_dis_int2: disable pull down on int2 pin.

- drive-open-drain: configure int pin in open drain. Default is disabled.

Example for an spi device node:

lis2duxs12-accel@0 {
        compatible = "st,lis2duxs12";
        reg = <0x0>;
        spi-max-frequency = <10000000>;
        interrupt-parent = <&gpio0>;
        interrupts = <0 IRQ_TYPE_LEVEL_HIGH>;
        st,int-pin = <1>;
};

Example for an i2c device node (I2C slave address 0x19):

lis2duxs12-accel@19 {
        compatible = "st,lis2duxs12";
        reg = <0x19>;
        interrupt-parent = <&gpio0>;
        interrupts = <0 IRQ_TYPE_LEVEL_HIGH>;
        st,int-pin = <1>;
};
```

## Documentation/devicetree/bindings/iio/stm/humidity/hts221.txt
```
* hts221 driver for humidity and temperature MEMS sensor

Required properties for all bus drivers:
- compatible: must be one of:
              "st,st_hts221"

Required properties for the i2c bindings:
- reg:        i2c slave address

Required properties for the spi bindings:
- reg:        the chipselect index

- spi-max-frequency: maximal bus speed, should be set to 10000000 unless
                     constrained by external circuitry

Optional properties for all bus drivers:
- interrupts: interrupt mapping for IRQ. It should be configured with
              flags IRQ_TYPE_LEVEL_HIGH.

              Refer to interrupt-controller/interrupts.txt for generic interrupt
              client node bindings.

- drive-open-drain: configure int pin in open drain.

Example for an spi device node:

hts221@0 {
        compatible = "st,st_hts221";
        reg = <0x0>;
        spi-max-frequency = <10000000>;
        interrupt-parent = <&gpio0>;
        interrupts = <0 IRQ_TYPE_LEVEL_HIGH>;
};

Example for an i2c device node:

hts221@5f {
        compatible = "st,st_hts221";
        reg = <0x5f>;
        interrupt-parent = <&gpio0>;
        interrupts = <0 IRQ_TYPE_LEVEL_HIGH>;
};
```

## Documentation/devicetree/bindings/iio/stm/imu/st_asm330lhhx.txt
```
* st_asm330lhhx driver for imu MEMS sensors

Required properties for all bus drivers:
- compatible: must be one of:
              "st,asm330lhh"
              "st,asm330lhhx"
              "st,asm330lhhxg1"
              "st,asm330lhb"

Required properties for the i2c bindings:
- reg:            i2c slave address

Required properties for the spi bindings:
- reg:            the chipselect index

- spi-max-frequency: maximal bus speed, should be set to 10000000 unless
                     constrained by external circuitry

Optional properties for all bus drivers:
- vdd-supply:     an optional regulator that needs to be on to provide
                  VDD power to the sensor.

- vddio-supply:   an optional regulator that needs to be on to provide
                  the VDD IO power to the sensor.

- st,int-pin:     the pin on the package that will be used to signal
                  "data ready" (valid values: 1 or 2, default: 1).

- st,mlc-int-pin: the pin on the package that will be used to signal
                  MLC/FSM event (valid values: 1 for int pin 1, 2 for
                  int pin 2 or 3 for both int pin, default: st,int-pin).

- st,wakeup-int-pin: the pin on the package that will be used to signal
                  embedded function event (valid values: 1 for int pin 1,
                  2 for int pin 2, default: st,int-pin).

- mount-matrix:   mount rotation matrix.

                  Refer to iio/mount-matrix.txt for details.

- interrupts:     interrupt mapping for IRQ. It should be configured
                  with flags IRQ_TYPE_LEVEL_HIGH, IRQ_TYPE_LEVEL_LOW,
                  IRQ_TYPE_EDGE_RISING or IRQ_TYPE_EDGE_FALLING. If the
                  interrupt is configured as edge trigger, each interrupt will
                  require multiple accesses to the configuration registers, so
                  using it in this mode is not recommended.

                  This property can also contain an array of two elements, the
                  first of which refers to the data irq while the second, if present,
                  refers to the embedded function irq line. The second element
                  should preferably be configured as edge-triggered when configured
                  to wake-up the system to limit the number of generated interrupts
                  during the resume phase. In any case the active level of the
                  interrupt pin is decided by the index 0 of the vector since it
                  is not possible to configure them separately.

                  Refer to interrupt-controller/interrupts.txt for
                  generic interrupt client node bindings.

- interrupts-extended: interrupt mapping for IRQ when a node needs to reference
                  multiple interrupt parents or a different interrupt parent
                  than the inherited one. It should be configured with flags
                  IRQ_TYPE_LEVEL_HIGH, IRQ_TYPE_LEVEL_LOW, IRQ_TYPE_EDGE_RISING
                  or IRQ_TYPE_EDGE_FALLING.

                  Please see the above "interrupts" property.

                  Refer to interrupt-controller/interrupts.txt for
                  generic interrupt client node bindings.

- st,module_id:   module identifier.
                  This is used by user-space to identify which devices
                  are part of the same module (particularly important for
                  supporting multiple sensors of the same type).

- st,xl_lpf_div: Bandwidth XL ODR divider, if set the value must be within
                 the range [2, 800].

- st,g_lpf_ftype: This property is the Gyro FTYPE value in the CTRL6_C register,
                  if set the value must be within the range [0, 7].

- wakeup-source:  https://www.kernel.org/doc/Documentation/devicetree/bindings/power/wakeup-source.txt

Example for an spi asm330lhh device node:

asm330lhh-imu@0 {
        compatible = "st,asm330lhh";
        reg = <0x0>;
        spi-max-frequency = <10000000>;
        interrupt-parent = <&gpio0>;
        interrupts = <0 IRQ_TYPE_LEVEL_HIGH>, <1 IRQ_TYPE_EDGE_RISING>;
        vddio-supply = <&sensors_vddio>;
        vdd-supply = <&sensors_vdd>;
        st,int-pin = <1>;
        st,mlc-int-pin = <2>;
        st,wakeup-int-pin = <2>;
        st,module_id = <1>;
        mount-matrix = "1", "0", "0",
                       "0", "1", "0",
                       "0", "0", "1";
};

Example for an spi asm330lhh device node using interrupts-extended:
asm330lhh-imu@0 {
        compatible = "st,asm330lhh";
        reg = <0x0>;
        spi-max-frequency = <10000000>;
        interrupts-extended = <&gpio 0 IRQ_TYPE_LEVEL_HIGH>, <&gpio 1 IRQ_TYPE_EDGE_RISING>;
        vddio-supply = <&sensors_vddio>;
        vdd-supply = <&sensors_vdd>;
        st,int-pin = <1>;
        st,mlc-int-pin = <2>;
        st,wakeup-int-pin = <2>;
        st,module_id = <1>;
        mount-matrix = "1", "0", "0",
                       "0", "1", "0",
                       "0", "0", "1";
};

Example for an i2c asm330lhhx device node (SA0 pulled down):

asm330lhhx-imu@0x6a {
        compatible = "st,asm330lhhx";
        reg = <0x6a>;
        interrupt-parent = <&gpio0>;
        interrupts = <0 IRQ_TYPE_LEVEL_HIGH>;
        vddio-supply = <&sensors_vddio>;
        vdd-supply = <&sensors_vdd>;
        st,int-pin = <1>;
        st,mlc-int-pin = <2>;
        mount-matrix = "1", "0", "0",
                       "0", "1", "0",
                       "0", "0", "1";
};
```

## Documentation/devicetree/bindings/iio/stm/imu/st_ism330dhcx.txt
```
* st_ism330dhcx driver for imu MEMS sensors

Required properties for all bus drivers:
- compatible: must be one of:
              "st,ism330dhcx"

Required properties for the i2c bindings:
- reg:               i2c slave address

Required properties for the spi bindings:
- reg:                the chipselect index

- spi-max-frequency:  maximal bus speed, should be set to 10000000 unless
                      constrained by external circuitry

Optional properties  for all bus drivers:
- st,int-pin:        the pin on the package that will be used to signal
                     "data ready" (valid values: 1 or 2, default: 1).

- st,mlc-int-pin:    the pin on the package that will be used to signal
                     MLC/FSM event (valid values: 1 for int pin 1, 2 for
                     int pin 2 or 3 for both int pin, default: st,int-pin).

- drive-open-drain:  the interrupt/data ready line will be configured as open drain,
                     which is useful if several sensors share the same interrupt line.

- interrupts:        interrupt mapping for IRQ. It should be configured with
                     flags IRQ_TYPE_LEVEL_HIGH, IRQ_TYPE_EDGE_RISING,
                     IRQ_TYPE_LEVEL_LOW or IRQ_TYPE_EDGE_FALLING.

                     Refer to interrupt-controller/interrupts.txt for generic interrupt
                     client node bindings.

- drive-pullup-shub: enable pull up on the i2c master interface. Default is disabled.

- st,module_id:      module identifier.
                     This is used by user-space to identify which devices
                     are part of the same module (particularly important for
                     supporting multiple sensors of the same type).

- wakeup-source:     https://www.kernel.org/doc/Documentation/devicetree/bindings/power/wakeup-source.txt

Example for an spi device node:

ism330dhcx-imu@0 {
        compatible = "st,ism330dhcx";
        reg = <0x0>;
        spi-max-frequency = <10000000>;
        interrupt-parent = <&gpio0>;
        interrupts = <0 IRQ_TYPE_LEVEL_HIGH>;
        st,module_id = <1>;
        st,int-pin = <1>;
};

Example for an i2c device node:

ism330dhcx-imu@6b {
        compatible = "st,ism330dhcx";
        reg = <0x6b>;
        interrupt-parent = <&gpio0>;
        interrupts = <0 IRQ_TYPE_LEVEL_HIGH>;
        st,module_id = <1>;
        st,int-pin = <1>;
};
```

## drivers/iio/stm/accel/Kconfig
```kconfig
# SPDX-License-Identifier: GPL-2.0-only
#
# IIO Accelerometer drivers configuration
#
# When adding new entries keep the list in alphabetical order

menu "Accelerometer"

source "drivers/iio/stm/accel/st_acc33/Kconfig"
source "drivers/iio/stm/accel/st_h3lis331dl/Kconfig"
source "drivers/iio/stm/accel/st_iis2iclx/Kconfig"
source "drivers/iio/stm/accel/st_ism303dac_accel/Kconfig"
source "drivers/iio/stm/accel/st_lis2ds12/Kconfig"
source "drivers/iio/stm/accel/st_lis2du12/Kconfig"
source "drivers/iio/stm/accel/st_lis2duxs12/Kconfig"
source "drivers/iio/stm/accel/st_lis2dw12/Kconfig"
source "drivers/iio/stm/accel/st_lis2hh12/Kconfig"
source "drivers/iio/stm/accel/st_lis3dhh/Kconfig"

endmenu
```
