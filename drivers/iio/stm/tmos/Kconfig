## drivers/iio/stm/tmos/Kconfig
```kconfig
# SPDX-License-Identifier: GPL-2.0-only
menu "Tmos"

source "drivers/iio/stm/tmos/st_sths34pf80/Kconfig"

endmenu
```

## stm_iio_configs/asm330lhhx_defconfig
```kconfig
CONFIG_IIO_ST_ASM330LHHX=m
CONFIG_IIO_ST_ASM330LHHX_I2C=m
CONFIG_IIO_ST_ASM330LHHX_SPI=m
```

## stm_iio_configs/iis2iclx_defconfig
```kconfig
CONFIG_IIO_ST_IIS2ICLX=m
CONFIG_IIO_ST_IIS2ICLX_I2C=m
CONFIG_IIO_ST_IIS2ICLX_SPI=m
```

## stm_iio_configs/ism303dac_defconfig
```kconfig
CONFIG_IIO_ST_ISM303DAC=m
CONFIG_IIO_ST_ISM303DAC_I2C=m
CONFIG_IIO_ST_ISM303DAC_SPI=m
CONFIG_ST_ISM303DAC_IIO_LIMIT_FIFO=0
```

## stm_iio_configs/ism330dlc_defconfig
```kconfig
CONFIG_ST_ISM330DLC_IIO=m
CONFIG_ST_ISM330DLC_I2C_IIO=m
CONFIG_ST_ISM330DLC_SPI_IIO=m
CONFIG_ST_ISM330DLC_IIO_LIMIT_FIFO=0
CONFIG_ST_ISM330DLC_IIO_MASTER_SUPPORT=y
CONFIG_ST_ISM330DLC_IIO_EXT0_LIS2MDL=y
```

## stm_iio_configs/lsm6ds3_defconfig
```kconfig
CONFIG_ST_LSM6DS3_IIO=m
CONFIG_ST_LSM6DS3_I2C_IIO=m
CONFIG_ST_LSM6DS3_SPI_IIO=m
CONFIG_ST_LSM6DS3_IIO_LIMIT_FIFO=0
CONFIG_ST_LSM6DS3_IIO_MASTER_SUPPORT=y
CONFIG_ST_LSM6DS3_IIO_EXT0_LIS2MDL=y
```

## stm_iio_configs/lsm6ds3h_defconfig
```kconfig
CONFIG_ST_LSM6DS3H_IIO=m
CONFIG_ST_LSM6DS3H_I2C_IIO=m
CONFIG_ST_LSM6DS3H_SPI_IIO=m
CONFIG_ST_LSM6DS3H_IIO_LIMIT_FIFO=0
CONFIG_ST_LSM6DS3H_IIO_MASTER_SUPPORT=y
CONFIG_ST_LSM6DS3H_IIO_EXT0_LIS3MDL=y
```

## stm_iio_configs/lsm6dsm_defconfig
```kconfig
CONFIG_ST_LSM6DSM_IIO=m
CONFIG_ST_LSM6DSM_I2C_IIO=m
CONFIG_ST_LSM6DSM_SPI_IIO=m
CONFIG_ST_LSM6DSM_IIO_LIMIT_FIFO=0
CONFIG_ST_LSM6DSM_IIO_MASTER_SUPPORT=y
CONFIG_ST_LSM6DSM_IIO_EXT0_LIS2MDL=y
```

## stm_iio_configs/lsm6dsvx_defconfig
```kconfig
CONFIG_IIO_ST_LSM6DSVX=m
CONFIG_IIO_ST_LSM6DSVX_I2C=m
CONFIG_IIO_ST_LSM6DSVX_SPI=m
```

## stm_iio_configs/lsm6dsvxhg_defconfig
```kconfig
CONFIG_IIO_ST_LSM6DSVXHG=m
CONFIG_IIO_ST_LSM6DSVXHG_I2C=m
CONFIG_IIO_ST_LSM6DSVXHG_SPI=m
CONFIG_IIO_ST_LSM6DSVXHG_I3C=m
```
