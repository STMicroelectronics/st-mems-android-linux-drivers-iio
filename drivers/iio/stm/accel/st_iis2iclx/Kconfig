## drivers/iio/stm/accel/st_iis2iclx/Kconfig
```kconfig
# SPDX-License-Identifier: GPL-2.0-only

config IIO_ST_IIS2ICLX
	tristate "STMicroelectronics IIS2ICLX sensor"
	depends on (I2C || SPI)
	select IIO_BUFFER
	select IIO_KFIFO_BUF
	select IIO_TRIGGERED_BUFFER
	select IIO_ST_IIS2ICLX_I2C if (I2C)
	select IIO_ST_IIS2ICLX_SPI if (SPI_MASTER)
	help
	 Say yes here to build support for STMicroelectronics IIS2ICLX accel
	 sensor.

	 To compile this driver as a module, choose M here: the module
	 will be called st_iis2iclx.

config IIO_ST_IIS2ICLX_I2C
	tristate
	select REGMAP_I2C
	depends on IIO_ST_IIS2ICLX

config IIO_ST_IIS2ICLX_SPI
	tristate
	select REGMAP_SPI
	depends on IIO_ST_IIS2ICLX

config IIO_ST_IIS2ICLX_ASYNC_HW_TIMESTAMP
	bool "Enable async hw timestamp read"
	depends on IIO_ST_IIS2ICLX
	help
	 Enable async task that sends over hw timestamp events.

choice
	prompt "IIS2ICLX MLC firmware source"
	depends on IIO_ST_IIS2ICLX
	default IIO_ST_IIS2ICLX_MLC_NONE
	help
	  Please select the source for the Machine Learning Core (MLC) and
	  Finite State Machine (FSM) firmware blocks. This option allows
	  you to choose between loading a default preloaded sample, using
	  a custom built-in firmware image, or disabling it entirely.

config IIO_ST_IIS2ICLX_MLC_NONE
	bool "No MLC firmware source"
	help
	  Select this option to leave MLC/FSM firmware loading disabled.
	  No external configuration or sample firmware will be loaded into
	  the sensor during the driver initialization phase. Choose this if
	  you intend to configure the MLC/FSM registers from user space.

config IIO_ST_IIS2ICLX_MLC_PRELOAD
	bool "MLC preload sample configuration"
	help
	  If this option is enabled, the driver will load a sample
	  configuration into the MLC/FSM block during device probing.
	  The example file was created using the official configuration
	  repository published by STMicroelectronics for machine learning.

config IIO_ST_IIS2ICLX_MLC_BUILTIN_FIRMWARE
	bool "Built-in MLC firmware"
	help
	  Say yes here to build support for the built-in firmware for the
	  internal IIS2ICLX MLC/FSM block. This option compiles the
	  firmware directly into the kernel image or module, enabling the
	  driver to automatically program the sensor during the probe
	  routine without relying on external hotplug firmware loading.

	  The firmware file should be called st_iis2iclx_mlc.fw and must
	  be located into the local driver source directory.
endchoice
```

## drivers/iio/stm/accel/st_lis2duxs12/Kconfig
```kconfig
# SPDX-License-Identifier: GPL-2.0-only

config IIO_ST_LIS2DUXS12
	tristate "STMicroelectronics LIS2DUX12/LIS2DUXS12/IIS2DULPX sensors"
	depends on (I2C || SPI || I3C)
	select IIO_BUFFER
	select IIO_KFIFO_BUF
	select IIO_ST_LIS2DUXS12_I2C if (I2C)
	select IIO_ST_LIS2DUXS12_SPI if (SPI_MASTER)
	select IIO_ST_LIS2DUXS12_I3C if (I3C)
	help
	 Say yes here to build support for STMicroelectronics LIS2DUX(S)12 accel
	 sensors.

	 To compile this driver as a module, choose M here: the module
	 will be called lis2duxs12.

config IIO_ST_LIS2DUXS12_I2C
	tristate
	select REGMAP_I2C
	depends on IIO_ST_LIS2DUXS12

config IIO_ST_LIS2DUXS12_SPI
	tristate
	select REGMAP_SPI
	depends on IIO_ST_LIS2DUXS12

config IIO_ST_LIS2DUXS12_I3C
	tristate
	select REGMAP_I3C
	depends on IIO_ST_LIS2DUXS12

choice
	prompt "LIS2DUXS12 MLC firmware source"
	depends on IIO_ST_LIS2DUXS12
	default IIO_ST_LIS2DUXS12_MLC_NONE
	help
	  Please select the source for the Machine Learning Core (MLC) and
	  Finite State Machine (FSM) firmware blocks. This option allows
	  you to choose between loading a default preloaded sample, using
	  a custom built-in firmware image, or disabling it entirely.

config IIO_ST_LIS2DUXS12_MLC_NONE
	bool "No MLC firmware source"
	help
	  Select this option to leave MLC/FSM firmware loading disabled.
	  No external configuration or sample firmware will be loaded into
	  the sensor during the driver initialization phase. Choose this if
	  you intend to configure the MLC/FSM registers from user space.

config IIO_ST_LIS2DUXS12_MLC_PRELOAD
	bool "MLC preload sample configuration"
	help
	  If this option is enabled, the driver will load a sample
	  configuration into the MLC/FSM block during device probing.
	  The example file was created using the official configuration
	  repository published by STMicroelectronics for machine learning.

config IIO_ST_LIS2DUXS12_MLC_BUILTIN_FIRMWARE
	bool "Built-in MLC firmware"
	help
	  Say yes here to build support for the built-in firmware for the
	  internal LIS2DUXS12 MLC/FSM block. This option compiles the
	  firmware directly into the kernel image or module, enabling the
	  driver to automatically program the sensor during the probe
	  routine without relying on external hotplug firmware loading.

	  The firmware file should be called st_lis2duxs12_mlc.fw and must
	  be located into the local driver source directory.
endchoice
```

## drivers/iio/stm/imu/st_lsm6dsv16bx/Kconfig
```kconfig
# SPDX-License-Identifier: GPL-2.0-only

config IIO_ST_LSM6DSV16BX
	tristate "STMicroelectronics LSM6DSV16BX sensor"
	depends on (I2C || SPI)
	select IIO_BUFFER
	select IIO_TRIGGERED_BUFFER
	select IIO_ST_LSM6DSV16BX_I2C if (I2C)
	select IIO_ST_LSM6DSV16BX_SPI if (SPI_MASTER)
	select IIO_ST_LSM6DSV16BX_I3C if (I3C)
	help
	  Say yes here to build support for STMicroelectronics LSM6DSV16BX/LSM6DSV16B/ISM330BX
	  imu sensors.

	  To compile this driver as a module, choose M here: the module
	  will be called st_lsm6dsv16bx.

config IIO_ST_LSM6DSV16BX_I2C
	tristate
	depends on IIO_ST_LSM6DSV16BX

config IIO_ST_LSM6DSV16BX_SPI
	tristate
	depends on IIO_ST_LSM6DSV16BX

config IIO_ST_LSM6DSV16BX_I3C
	tristate
	depends on IIO_ST_LSM6DSV16BX
	select REGMAP_I3C

config IIO_ST_LSM6DSV16BX_ASYNC_HW_TIMESTAMP
	bool "Enable async hw timestamp read"
	depends on IIO_ST_LSM6DSV16BX
	help
	  Enable async task that sends over hw timestamp events.

choice
	prompt "LSM6DSV16BX MLC firmware source"
	depends on IIO_ST_LSM6DSV16BX
	default IIO_ST_LSM6DSV16BX_MLC_NONE
	help
	  Please select the source for the Machine Learning Core (MLC) and
	  Finite State Machine (FSM) firmware blocks. This option allows
	  you to choose between loading a default preloaded sample, using
	  a custom built-in firmware image, or disabling it entirely.

config IIO_ST_LSM6DSV16BX_MLC_NONE
	bool "No MLC firmware source"
	help
	  Select this option to leave MLC/FSM firmware loading disabled.
	  No external configuration or sample firmware will be loaded into
	  the sensor during the driver initialization phase. Choose this if
	  you intend to configure the MLC/FSM registers from user space.

config IIO_ST_LSM6DSV16BX_MLC_PRELOAD
	bool "MLC preload sample configuration"
	help
	  If this option is enabled, the driver will load a sample
	  configuration into the MLC/FSM block during device probing.
	  The example file was created using the official configuration
	  repository published by STMicroelectronics for machine learning.

config IIO_ST_LSM6DSV16BX_MLC_BUILTIN_FIRMWARE
	bool "Built-in MLC firmware"
	help
	  Say yes here to build support for the built-in firmware for the
	  internal LSM6DSV16BX MLC/FSM block. This option compiles the
	  firmware directly into the kernel image or module, enabling the
	  driver to automatically program the sensor during the probe
	  routine without relying on external hotplug firmware loading.

	  The firmware file should be called st_lsm6dsv16bx_mlc.fw and must
	  be located into the local driver source directory.
endchoice
```

## drivers/iio/stm/imu/st_lsm6dsvx/Kconfig
```kconfig
# SPDX-License-Identifier: GPL-2.0-only

config IIO_ST_LSM6DSVX
	tristate "STMicroelectronics LSM6DSVX sensor"
	depends on (I2C || SPI)
	select IIO_BUFFER
	select IIO_TRIGGERED_BUFFER
	select IIO_ST_LSM6DSVX_I2C if (I2C)
	select IIO_ST_LSM6DSVX_SPI if (SPI_MASTER)
	select IIO_ST_LSM6DSVX_I3C if (I3C)
	help
	  Say yes here to build support for STMicroelectronics LSM6DSVX imu
	  sensor.

	  To compile this driver as a module, choose M here: the module
	  will be called st_lsm6dsvx.

config IIO_ST_LSM6DSVX_I2C
	tristate
	depends on IIO_ST_LSM6DSVX

config IIO_ST_LSM6DSVX_SPI
	tristate
	depends on IIO_ST_LSM6DSVX

config IIO_ST_LSM6DSVX_I3C
	tristate
	depends on IIO_ST_LSM6DSVX
	select REGMAP_I3C

config IIO_ST_LSM6DSVX_QVAR_IN_FIFO
	bool "use FIFO for QVAR"
	depends on IIO_ST_LSM6DSVX
	help
	  Enable support to QVAR sensor on internal HW FIFO

config IIO_ST_LSM6DSVX_ASYNC_HW_TIMESTAMP
	bool "Enable async hw timestamp read"
	depends on IIO_ST_LSM6DSVX
	help
	  Enable async task that sends over hw timestamp events.

choice
	prompt "LSM6DSVX MLC firmware source"
	depends on IIO_ST_LSM6DSVX
	default IIO_ST_LSM6DSVX_MLC_NONE
	help
	  Please select the source for the Machine Learning Core (MLC) and
	  Finite State Machine (FSM) firmware blocks. This option allows
	  you to choose between loading a default preloaded sample, using
	  a custom built-in firmware image, or disabling it entirely.

config IIO_ST_LSM6DSVX_MLC_NONE
	bool "No MLC firmware source"
	help
	  Select this option to leave MLC/FSM firmware loading disabled.
	  No external configuration or sample firmware will be loaded into
	  the sensor during the driver initialization phase. Choose this if
	  you intend to configure the MLC/FSM registers from user space.

config IIO_ST_LSM6DSVX_MLC_PRELOAD
	bool "MLC preload sample configuration"
	help
	  If this option is enabled, the driver will load a sample
	  configuration into the MLC/FSM block during device probing.
	  The example file was created using the official configuration
	  repository published by STMicroelectronics for machine learning.

config IIO_ST_LSM6DSVX_MLC_BUILTIN_FIRMWARE
	bool "Built-in MLC firmware"
	help
	  Say yes here to build support for the built-in firmware for the
	  internal LSM6DSVX MLC/FSM block. This option compiles the
	  firmware directly into the kernel image or module, enabling the
	  driver to automatically program the sensor during the probe
	  routine without relying on external hotplug firmware loading.

	  The firmware file should be called st_lsm6dsvx_mlc.fw and must
	  be located into the local driver source directory.
endchoice
```

## drivers/iio/stm/imu/st_lsm6dsvxhg/Kconfig
```kconfig
# SPDX-License-Identifier: GPL-2.0-only

config IIO_ST_LSM6DSVXHG
	tristate "STMicroelectronics LSM6DSVXHG sensor"
	depends on (I2C || SPI)
	select IIO_BUFFER
	select IIO_TRIGGERED_BUFFER
	select IIO_ST_LSM6DSVXHG_I2C if (I2C)
	select IIO_ST_LSM6DSVXHG_SPI if (SPI_MASTER)
	select IIO_ST_LSM6DSVXHG_I3C if (I3C)
	help
	  Say yes here to build support for STMicroelectronics LSM6DSVXHG imu
	  sensor.

	  To compile this driver as a module, choose M here: the module
	  will be called st_lsm6dsvxhg.

config IIO_ST_LSM6DSVXHG_I2C
	tristate
	depends on IIO_ST_LSM6DSVXHG

config IIO_ST_LSM6DSVXHG_SPI
	tristate
	depends on IIO_ST_LSM6DSVXHG

config IIO_ST_LSM6DSVXHG_I3C
	tristate
	depends on IIO_ST_LSM6DSVXHG
	select REGMAP_I3C

config IIO_ST_LSM6DSVXHG_ASYNC_HW_TIMESTAMP
	bool "Enable async hw timestamp read"
	depends on IIO_ST_LSM6DSVXHG
	help
	  Enable async task that sends over hw timestamp events.

choice
	prompt "LSM6DSVXHG MLC firmware source"
	depends on IIO_ST_LSM6DSVXHG
	default IIO_ST_LSM6DSVXHG_MLC_NONE
	help
	  Please select the source for the Machine Learning Core (MLC) and
	  Finite State Machine (FSM) firmware blocks. This option allows
	  you to choose between loading a default preloaded sample, using
	  a custom built-in firmware image, or disabling it entirely.

config IIO_ST_LSM6DSVXHG_MLC_NONE
	bool "No MLC firmware source"
	help
	  Select this option to leave MLC/FSM firmware loading disabled.
	  No external configuration or sample firmware will be loaded into
	  the sensor during the driver initialization phase. Choose this if
	  you intend to configure the MLC/FSM registers from user space.

config IIO_ST_LSM6DSVXHG_MLC_PRELOAD
	bool "MLC preload sample configuration"
	help
	  If this option is enabled, the driver will load a sample
	  configuration into the MLC/FSM block during device probing.
	  The example file was created using the official configuration
	  repository published by STMicroelectronics for machine learning.

config IIO_ST_LSM6DSVXHG_MLC_BUILTIN_FIRMWARE
	bool "Built-in MLC firmware"
	help
	  Say yes here to build support for the built-in firmware for the
	  internal LSM6DSVXHG MLC/FSM block. This option compiles the
	  firmware directly into the kernel image or module, enabling the
	  driver to automatically program the sensor during the probe
	  routine without relying on external hotplug firmware loading.

	  The firmware file should be called st_lsm6dsvxhg_mlc.fw and must
	  be located into the local driver source directory.
endchoice
```
